## boards/shields/eyelash_sofle/Kconfig.shield
```kconfig
# Copyright (c) 2020 The ZMK Contributors
# SPDX-License-Identifier: MIT

config SHIELD_EYELASH_SOFLE_LEFT
    def_bool $(shields_list_contains,eyelash_sofle_left)

config SHIELD_EYELASH_SOFLE_RIGHT
    def_bool $(shields_list_contains,eyelash_sofle_right)

config SHIELD_EYELASH_SOFLE_DONGLE_LEFT
    def_bool $(shields_list_contains,eyelash_sofle_dongle_left)

config SHIELD_EYELASH_SOFLE_DONGLE_RIGHT
    def_bool $(shields_list_contains,eyelash_sofle_dongle_right)
```

## config/west.yml
```yaml
manifest:
  remotes:
    - name: zmkfirmware
      url-base: https://github.com/zmkfirmware
    - name: cormoran
      url-base: https://github.com/cormoran
  projects:
    - name: eyelash_sofle
      url: https://github.com/a741725193/zmk-sofle
      revision: cad147725279b0635a3d512ac99f6668bfec3704
    - name: nanopb
      url: https://github.com/zmkfirmware/nanopb
      revision: 8c60555d6277a0360c876bd85d491fc4fb0cd74a
      path: modules/lib/nanopb
    - name: zephyr
      remote: zmkfirmware
      revision: dacab4875df72109b96cc8977547a0dc04875bcd
      import:
        name-blocklist:
          - ci-tools
          - hal_altera
          - hal_cypress
          - hal_infineon
          - hal_microchip
          - hal_nxp
          - hal_openisa
          - hal_silabs
          - hal_xtensa
          - hal_st
          - hal_ti
          - loramac-node
          - mcuboot
          - mcumgr
          - net-tools
          - openthread
          - edtt
          - trusted-firmware-m
    - name: zmk
      remote: cormoran
      revision: 4493783ef88ce2e653bf8217c92ee17140df71e3
      import: app/west.yml
    - name: zmk-behavior-runtime-sensor-rotate
      remote: cormoran
      revision: 8b1125ed676c1f5e14145d217984f33d0ebdcef4
    - name: zmk-module-ble-management
      remote: cormoran
      revision: 851661cd21f2aded8ec649da86e01a207dc4b973
    - name: zmk-module-battery-history
      remote: cormoran
      revision: 307755dd2ad4d320e14de162e8e5ef018f29d929
    - name: zmk-module-settings-rpc
      remote: cormoran
      revision: 78f86df9e6c5edaf57bef3ccbd7f360cfdf49291
    - name: zmk-module-runtime-input-processor
      remote: cormoran
      revision: dbf92f764de8b6ffd60bf5850514302875fe2570
  self:
    path: config
```

## dts/bindings/behaviors/zmk,behavior-dongle-soft-off.yaml
```yaml
description: Dongle peripheral-only soft off
compatible: "zmk,behavior-dongle-soft-off"
include: zero_param.yaml
```
