## boards/shields/sofle_dongle/Kconfig.shield
```kconfig
config SHIELD_SOFLE_DONGLE
    def_bool $(shields_list_contains,sofle_dongle) || $(shields_list_contains,sofle_dongle_wireless)

config SHIELD_SOFLE_DONGLE_WIRELESS
    def_bool $(shields_list_contains,sofle_dongle_wireless)
```

## dts/bindings/behaviors/zmk,behavior-host-clear.yaml
```yaml
description: Hold for two seconds to clear only PC host bonds
compatible: "zmk,behavior-host-clear"
include: one_param.yaml
```

## dts/bindings/behaviors/zmk,behavior-host-menu.yaml
```yaml
description: Open the wireless dongle Bluetooth menu
compatible: "zmk,behavior-host-menu"
include: zero_param.yaml
```
